## boards/arm/tbot/Kconfig.board
```kconfig
# TBOT board configuration

# Copyright (c) 2016 Linaro Limited.
# SPDX-License-Identifier: Apache-2.0

config BOARD_TBOT
	bool "TBot board based on STM32F405"
	depends on SOC_STM32F405XG
```

## boards/arm/tbot/tbot_defconfig
```kconfig
# SPDX-License-Identifier: Apache-2.0

# Select SOC
CONFIG_SOC_SERIES_STM32F4X=y
CONFIG_SOC_STM32F405XG=y

# Enable RCC
CONFIG_CLOCK_CONTROL=y

# Enable MPU
CONFIG_ARM_MPU=y

# Enable FPU
CONFIG_FPU=y

# Enable HW stack protection
CONFIG_HW_STACK_PROTECTION=y

# Enable RTOS Debugging
CONFIG_DEBUG_THREAD_INFO=y

CONFIG_SERIAL=y

# console
CONFIG_CONSOLE=y
CONFIG_UART_CONSOLE=y

# Enable Pinmux & GPIO
# CONFIG_PINMUX=y
CONFIG_GPIO=y

# Enable pin controller
CONFIG_PINCTRL=y
```

## boards/arm/tbot_io/Kconfig.board
```kconfig
# tbot_io board configuration

# Copyright (c) 2024 Ruixiang Du (rdu)

config BOARD_TBOT_IO
	bool "TBot IO Board: tbot_io"
	depends on SOC_STM32F405XG
```

## boards/arm/tbot_io/Kconfig.defconfig
```kconfig
# tbot_io board configuration

# Copyright (c) 2022 Ruixiang Du (rdu)

if BOARD_TBOT_IO

config BOARD
	default "tbot_io"

endif # BOARD_TBOT_IO
```

## drivers/Kconfig
```kconfig
# Copyright (c) 2021 Nordic Semiconductor ASA
# SPDX-License-Identifier: Apache-2.0

menu "Drivers"
rsource "zdrv_async_uart/Kconfig"
rsource "blink/Kconfig"
rsource "sensor/Kconfig"
endmenu
```

## drivers/zdrv_async_uart/Kconfig
```kconfig
# Copyright (c) 2024 Nordic Semiconductor ASA
# SPDX-License-Identifier: Apache-2.0

menuconfig ZDRV_ASYNC_UART
	bool "Libzdriver asynchronous UART driver"
	select UART_ASYNC_API
	help
	  This option enables the asynchronous UART driver class.

if ZDRV_ASYNC_UART

config ZDRV_ASYNC_UART_INIT_PRIORITY
	int "Blink device drivers init priority"
	default KERNEL_INIT_PRIORITY_DEVICE
	help
	  Blink device drivers init priority.

module = ZDRIVERS
module-str = zdrivers
source "subsys/logging/Kconfig.template.log_config"

endif # ZDRV_ASYNC_UART
```

## src/robotio/Kconfig
```kconfig
# Copyright (c) 2021, Legrand North America, LLC.
# SPDX-License-Identifier: Apache-2.0

config ROBOTIO
	bool "Support for robot io"
	help
	  This option enables the 'robot io' library.

	  The 'robot io' library provides a simple API for utilizing MCU peripherals to
	  control a robot. The library is intended to be used with a robot that has
	  motors, sensors, and other peripherals that can be controlled by an MCU.

config ROBOTIO_GET_VALUE_DEFAULT
	int "custom_get_value() default return value"
	depends on ROBOTIO
	default 0
	help
	  This option primarily exists as an example of a library Kconfig
	  setting.

	  This option specifies the value for custom_get_value() to return
	  when the input parameter is zero. (Otherwise the function returns the
	  input parameter value.)
```

## src/sbus/Kconfig
```kconfig
# Copyright (c) 2021, Legrand North America, LLC.
# SPDX-License-Identifier: Apache-2.0

config SBUS
	bool "Support for sbus"
	help
	  This option enables the 'sbus' library

config SBUS_GET_VALUE_DEFAULT
	int "custom_get_value() default return value"
	depends on SBUS
	default 0
	help
	  This option primarily exists as an example of a library Kconfig
	  setting.

	  This option specifies the value for custom_get_value() to return
	  when the input parameter is zero. (Otherwise the function returns the
	  input parameter value.)
```

## src/vesc/Kconfig
```kconfig
# Copyright (c) 2021, Legrand North America, LLC.
# SPDX-License-Identifier: Apache-2.0

config VESC
	bool "Support for VESC"
    depends on CAN
	help
	  This option enables the 'VESC' library

config VESC_MCU_ID
	hex "MCU ID"
	depends on VESC
	default 0x60
	help
	  This option specified the ID of the MCU controlling the VESC.

config VESC_VESC_ID
	hex "VESC ID"
	depends on VESC
	default 0x68
	help
	  This option specified the target VESC ID.
```
