## CMakeLists.txt
```
#-------------------------------------------------------------------------------
# Zephyr Example Application
#
# Copyright (c) 2021 Nordic Semiconductor ASA
# SPDX-License-Identifier: Apache-2.0

cmake_minimum_required(VERSION 3.13.1)
find_package(Zephyr REQUIRED HINTS $ENV{ZEPHYR_BASE})

project(app LANGUAGES C)

if (CONFIG_BOARD_TBOT)
    message(STATUS "Building with BSP: tbot")
    set(BSP_SRC src/bsp/tbot_bsp.c)
endif ()

target_sources(app PRIVATE src/main.c ${BSP_SRC})
target_include_directories(app PRIVATE src)
```

## prj.conf
```kconfig
# Copyright (c) 2021 Nordic Semiconductor ASA
# SPDX-License-Identifier: Apache-2.0
#
# This file contains selected Kconfig options for the application.

CONFIG_THREAD_ANALYZER=y
CONFIG_THREAD_ANALYZER_USE_PRINTK=y

CONFIG_ZDRV_ASYNC_UART=y

#CONFIG_SERIAL=y
CONFIG_UART_ASYNC_API=y

CONFIG_CAN=y

CONFIG_SENSOR=y
# CONFIG_BLINK=y
# CONFIG_BLINK_GPIO_LED=y
CONFIG_SBUS=y
CONFIG_VESC=y
```

## src/main.c
```c
/*
 * Copyright (c) 2021 Nordic Semiconductor ASA
 * SPDX-License-Identifier: Apache-2.0
 */

#include <zephyr/kernel.h>
#include <zephyr/logging/log.h>
#include <zephyr/drivers/gpio.h>
#include <zephyr/debug/thread_analyzer.h>

#include <app_version.h>

#include "bsp/tbot_bsp.h"

LOG_MODULE_REGISTER(main, CONFIG_APP_LOG_LEVEL
);

int main(void) {
    printk("Zephyr Example Application %s\n", APP_VERSION_STRING);

    if (InitBoard() == false) {
        return -1;
    }

    ToggleLED(LED2);

//    TestUartRx();

    while (1) {
//        thread_analyzer_print();

        ToggleLED(LED1);
        ToggleLED(LED2);
        ToggleLED(LED3);

//        TestUartTx();
        k_sleep(K_MSEC(500));
    }

    return 0;
}
```

## src/hello.c
```c
/*
 * Copyright (c) 2021 Nordic Semiconductor ASA
 * SPDX-License-Identifier: Apache-2.0
 */

#include <zephyr/kernel.h>
#include <zephyr/logging/log.h>

#include <app_version.h>

LOG_MODULE_REGISTER(main, CONFIG_APP_LOG_LEVEL);

int main(void)
{
    printk("Zephyr Example Application %s\n", APP_VERSION_STRING);

    while (1) {
        k_sleep(K_MSEC(100));
    }

    return 0;
}
```
